## samples/esp-idf/sat-dual-stack-nesso-n1/components/diag_clock_drift/Kconfig
```kconfig
# Copyright (c) 2026 Hubble Network, Inc.
# SPDX-License-Identifier: Apache-2.0

menu "Clock drift diagnostic"

    config DIAG_CLOCK_DRIFT
    bool "Measure the crystal against USB SOF and log satellite TX"
    default n
    depends on IDF_TARGET_ESP32C6
    help
        Prints DRIFT lines (crystal offset against the host's 1 kHz USB
        start-of-frame, plus die temperature) every window, a TX line for
        each satellite packet, and a HOP line for each of its frames with
        the frequency the radio was set to. Off in normal builds.

    config DIAG_CLOCK_DRIFT_WINDOW_S
    int "Measurement window, in seconds"
    default 5
    range 1 60
    depends on DIAG_CLOCK_DRIFT
    help
        Longer windows give finer ppm resolution and fewer samples.

    config DIAG_TX_START_DELAY_S
    int "Hold the first satellite packet until this many seconds after boot"
    default 0
    range 0 3600
    depends on DIAG_CLOCK_DRIFT
    help
        0 leaves TX timing as it is. Use it to see whether corrections
        follow time since power-on rather than the first transmissions.

    config DIAG_TX_POWER_SWEEP
    bool "Replace satellite passes with a TX power sweep"
    default n
    depends on DIAG_CLOCK_DRIFT
    help
        After init, sends 13-byte satellite packets back to back at each
        power level, up from 0 dBm to 20 dBm and back down, with an idle
        gap between levels. Prints a SWEEP line at each level start and
        end so the DRIFT lines can show crystal pull against PA power.
        The device makes no scheduled passes in this mode.

    config DIAG_SWEEP_STEP_DBM
    int "Power step, in dBm"
    default 5
    range 1 20
    depends on DIAG_TX_POWER_SWEEP

    config DIAG_SWEEP_ON_S
    int "Seconds of back-to-back TX at each level"
    default 60
    range 5 600
    depends on DIAG_TX_POWER_SWEEP
    help
        Use at least several drift windows, so the module reaches a
        steady temperature.

    config DIAG_SWEEP_OFF_S
    int "Idle seconds between levels"
    default 60
    range 0 600
    depends on DIAG_TX_POWER_SWEEP
    help
        The idle gap gives each level its own baseline.

endmenu
```

## samples/esp-idf/sat-dual-stack-nesso-n1/main/Kconfig.projbuild
```kconfig
# Copyright (c) 2026 Hubble Network, Inc.
# SPDX-License-Identifier: Apache-2.0

menu "Sat Dual Stack Nesso N1 Sample Configuration"

    orsource "$IDF_PATH/examples/common_components/env_caps/$IDF_TARGET/Kconfig.env_caps"

    config HUBBLE_DEVICE_KEY
    string "Cryptography key in base64"
    default ""
    help
        Hubble device's cryptographic key

    config HUBBLE_SAMPLE_DEBUG
    bool "Enable debug mode"
    default n
    help
        Enable debug mode for the Hubble sample application.
        This will set the sat timer for 2 minutes instead
        of until a satellite pass is overhead.

    config HUBBLE_SAMPLE_WIFI_SSID
    string "Wi-Fi SSID for time sync"
    default ""
    help
        Wi-Fi network used at boot to get the time over SNTP. With a
        saved setup (location and ephemeris from a previous run of
        dual-stack-companion.py), the device then resumes without the
        companion. Leave empty to always wait for the companion.

    config HUBBLE_SAMPLE_WIFI_PASSWORD
    string "Wi-Fi password for time sync"
    default ""

    config HUBBLE_SAMPLE_SNTP_SERVER
    string "SNTP server"
    default "pool.ntp.org"

    config HUBBLE_SAMPLE_HOME_SCAN_MINUTES
    int "Minutes between home Wi-Fi checks (0 = off)"
    default 10
    range 0 1440
    help
        While the Wi-Fi network above is in range, the device is assumed
        to be at home and beacons less often to save battery. It checks
        with a short scan this often.

    config HUBBLE_SAMPLE_HOME_BEACON_INTERVAL_MS
    int "Beacon interval at home, in milliseconds"
    default 10000
    range 1000 10000

    config HUBBLE_SAMPLE_POWER_TEST
    bool "Run the A/B battery-draw test once per build"
    default n
    help
        For battery-life work. About 20 s after boot, puts the charger in
        Hi-Z so the board runs from its battery while on USB, then steps
        through LoRa, Grove and BLE settings for 2.5 min each and logs the
        draw of each at the next boot. Also turn off
        CONFIG_USJ_NO_AUTO_LS_ON_CONNECTION, or USB keeps the chip awake.

    config HUBBLE_SAMPLE_SLEEP_FLOOR_TEST
    bool "Measure the board's deep-sleep floor instead of running the sample"
    default n
    help
        For battery-life work. On battery, the board turns off the display,
        LoRa and Grove power, then deep sleeps for 60 s at a time. At each
        wake it saves the fuel gauge's average current. On USB it prints
        the saved samples and waits; unplugging starts a new run.

    config HUBBLE_SAMPLE_TZ
    string "Time zone for pass times (POSIX TZ)"
    default "PST8PDT,M3.2.0,M11.1.0"
    help
        Pass times on screen are shown in this time zone. The default is
        US Pacific time with daylight saving.

    config HUBBLE_SAMPLE_TZ_LABEL
    string "Time zone label shown after pass times"
    default "PT"

    config HUBBLE_SAMPLE_SETUP_MAX_AGE_DAYS
    int "Days a saved setup is used without the companion"
    default 7
    range 1 365
    help
        Satellite ephemeris goes stale. After this many days since the
        last run of dual-stack-companion.py, the device waits for the
        companion again instead of resuming from the saved setup.

endmenu
```
